## config/west.yml
```yaml
manifest:
  remotes:
    - name: zmkfirmware
      url-base: https://github.com/zmkfirmware
    - name: kumamuk-git
      url-base: https://github.com/kumamuk-git
    - name: hsgw
      url-base: https://github.com/hsgw
    - name: caksoylar  # <-- led
      url-base: https://github.com/caksoylar

  projects:
    # ZMK 本体。公式の app/west.yml を取り込む
    - name: zmk
      remote: zmkfirmware
      revision: v0.3
      import: app/west.yml

    # PMW3610 ドライバ（kumamuk-git版: scroll-layers/automouse-layer内蔵）
    - name: zmk-pmw3610-driver
      remote: kumamuk-git
      revision: main

    # Sensor-rotation
    - name: zmk-feature-sensor_rotation
      remote: hsgw
      revision: main

    # LED
    - name: zmk-rgbled-widget  # <-- led
      remote: caksoylar
      revision: v0.3

  self:
    path: config
```
